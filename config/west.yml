## config/west.yml
```yaml
manifest:
  remotes:
    - name: cormoran
      url-base: https://github.com/cormoran
    - name: badjeff    # <-- PMW3610
      url-base: https://github.com/badjeff
    - name: caksoylar  # <-- RGB LED
      url-base: https://github.com/caksoylar
    - name: takamaru-fpv  # <-- Battery level smoothing
      url-base: https://github.com/takamaru-fpv
    - name: onoWasabi     # <-- NICOLA (親指シフト) behavior module
      url-base: https://github.com/onoWasabi

  projects:
    # ZMK: DYA Studio 用カスタム RPC サブシステム付き cormoran fork
    - name: zmk
      remote: cormoran
      # v0.3-branch+dya の 2026-05-01 known-good 時点にピン留め。cormoran モジュール群を
      # revision:main のまま追従させると zmk_keymap_layer_activate の引数不一致でR側が
      # ビルド不可になる(upstream drift)ため、zmk とモジュールを同一時点へ固定する。
      revision: e5397fd8588d691f7dae08c1f9f55667e38be287
      import: app/west.yml
    - name: zmk-feature-non-lipo-battery-management
      remote: takamaru-fpv
      revision: voltage_division

    # DYA Studio モジュール（すべて cormoran リポジトリ）
    - name: zmk-module-ble-management
      remote: cormoran
      revision: 851661cd21f2aded8ec649da86e01a207dc4b973
    - name: zmk-module-battery-history
      remote: cormoran
      revision: 307755dd2ad4d320e14de162e8e5ef018f29d929
    - name: zmk-module-settings-rpc
      remote: cormoran
      revision: ad1c995cf910ca989ecd6352a1d0b41ccb18362c
    - name: zmk-module-runtime-input-processor
      remote: cormoran
      # ★e643dfe(2026-04-30 "Migrate to zmk v4")以降は zmk_keymap_layer_activate が2引数化し
      # v0.3 fork(1引数)でビルド不可。v4移行前(Feb-24, 1引数)にピン留めして整合させる。
      revision: dbf92f764de8b6ffd60bf5850514302875fe2570
    - name: zmk-pmw3610-driver
      remote: badjeff
      revision: zmk-0.3
    - name: zmk-rgbled-widget
      remote: caksoylar
      revision: v0.3-branch
    # NICOLA 親指シフト behavior (&ni)。roBa と同一モジュール。cormoran/zmk は v0.3 系
    # なので v0.3-branch 向けの本モジュールがそのままビルドできる想定。
    - name: zmk-nicola
      remote: onoWasabi
      revision: main
  self:
    path: config
```
